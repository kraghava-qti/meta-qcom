## conf/machine/glymur-crd.conf
```bitbake
#@TYPE: Machine
#@NAME: Qualcomm SM8750 Development Kit
#@DESCRIPTION: Machine configuration for Qualcomm SM8750 development Kit

require conf/machine/include/glymur-crd.inc

MACHINE_FEATURES = "efi usbhost usbgadget alsa wifi bluetooth"

# QCOM_BOOTIMG_ROOTFS = "PARTLABEL=system"

QCOM_DTB_DEFAULT ?= "glymur-crd"

KERNEL_DEVICETREE ?= " \
                      qcom/glymur-crd.dtb \
                      "

QCOM_BOOT_FILES_SUBDIR = "glymur-crd"
QCOM_PARTITION_FILES_SUBDIR = "partitions/sm8750-mtp"
```

## conf/machine/include/glymur-crd.inc
```bitbake
# Configurations and variables for SM8750 SoC family.

SOC_FAMILY = "glymur"
require conf/machine/include/qcom-base.inc
require conf/machine/include/qcom-common.inc

DEFAULTTUNE = "armv8-2a-crypto"
require conf/machine/include/arm/arch-armv8-2a.inc

MACHINE_ESSENTIAL_EXTRA_RRECOMMENDS += " \
    packagegroup-qcom-boot-essential \
"

MACHINE_EXTRA_RRECOMMENDS += " \
    packagegroup-qcom-boot-additional \
"
```
